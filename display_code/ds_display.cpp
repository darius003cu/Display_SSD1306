#include "ds_display.h"

uint8_t ch_vect[13][8] = {
  {0x00, 0x7C, 0xFE, 0xB2, 0x9A, 0xFE, 0x7C, 0x00},
  {0x00, 0x80, 0x84, 0xFE, 0xFE, 0x80, 0x80, 0x00},
  {0x00, 0xC4, 0xE6, 0xB2, 0x92, 0xDE, 0xCC, 0x00},
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  {0x00, 0x00, 0x00, 0xC0, 0xC0, 0x00, 0x00, 0x00}
};

uint8_t disp_buffer[10];

void display_init(){
  disp_buffer[0] = SLAVE_W;
  disp_buffer[1] = 0x00;
  disp_buffer[2] = 0xAF;
  i2c_send(disp_buffer, 3);
}

void charge_pump(){
  disp_buffer[0] = SLAVE_W;
  disp_buffer[1] = 0x00;
  disp_buffer[2] = 0x8D;
  disp_buffer[3] = 0x14;
  i2c_send(disp_buffer, 4);
}

void clear_page(){
  i2c_send_zeroes();
}

void page_setup(uint8_t nr){
  if(nr >= 0 && nr < 8){
    disp_buffer[2] = 0xB0 | nr;
  }
  else{
    disp_buffer[2] = 0xB0;
  }
    
  disp_buffer[0] = SLAVE_W;
  disp_buffer[1] = 0x00;
  disp_buffer[3] = 0x00;
  disp_buffer[4] = 0x10;

  i2c_send(disp_buffer, 5);
}

void display_reset(){
  for(uint8_t i = 0; i < 8; i++) {
    page_setup(i);
    clear_page();
  }
}

void character_print(uint8_t index){
  if(index >= 0 && index < 13){
     disp_buffer[0] = SLAVE_W;
     disp_buffer[1] = 0x40;
     for(uint8_t i=2; i<10; i++){
       disp_buffer[i] = ch_vect[index][i - 2];
     }
     i2c_send(disp_buffer, 10);
  }
  else{   
    disp_buffer[0] = SLAVE_W;
    disp_buffer[1] = 0x40;
    for(uint8_t i=2; i<10; i++){
      disp_buffer[i] = ch_vect[EMPTY][i - 2];
    }
    i2c_send(disp_buffer, 10); 
  }
}
